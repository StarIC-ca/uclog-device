## drivers/Kconfig
```kconfig
# © 2025 Unit Circle Inc.
# SPDX-License-Identifier: Apache-2.0

menu "UC Drivers"
rsource "ucuart/Kconfig"
rsource "ucuart_z/Kconfig"
rsource "ucusb/Kconfig"
rsource "ucnet/Kconfig"
endmenu
```

## drivers/ucnet/Kconfig
```kconfig
# © 2026 StarIC Inc.
# SPDX-License-Identifier: Apache-2.0

config UCNET
	bool "ucLog over Network"
	default y
	depends on DT_HAS_STARIC_UCNET_ENABLED
	select NETWORKING
	select NET_SOCKETS
	select NET_SOCKETS_SERVICE
	select POSIX_API
	help
	  ucLog over TCP Network Sockets

if UCNET

config UCNET_TX_WQ_STACK_SIZE
	int "ucLog net TX workq stack size"
	default 2048

config UCNET_TX_WQ_THREAD_PRIORITY
	int "ucLog net TX workq thread priority"
	default 5

choice UCNET_PROTOCOL
	prompt "ucLog net protocol to use"
	default UCNET_PROTOCOL_TCP
	help
	  Select the network protocol to use (TCP/UDP)

config UCNET_PROTOCOL_TCP
	bool "Use TCP"
	select NET_TCP

config UCNET_PROTOCOL_UDP
	bool "Use UDP"
	select NET_UDP

endchoice

config UCNET_MDNS
	bool "Advertise ucLog service over mDNS"
	default n
	select MDNS_RESPONDER
	select DNS_SD
	select MDNS_RESPONDER_DNS_SD

if UCNET_MDNS

configdefault ZVFS_POLL_MAX
	default 5

configdefault NET_MAX_CONN
	default 8

configdefault NET_MAX_CONTEXTS
	default 8

endif

module = UCNET
module-str = ucnet
source "subsys/logging/Kconfig.template.log_config"

config UCNET_INIT_PRIORITY
	int "ucnet init priority"
	default 95
	help
	  ucLog driver initialization priority.
	  This must be higher than NET_INIT_PRIO, so network services (like socket service)
	  are initialized first

# Can include specific alternatives here e.g.
# rsource Kconfig.xxx

endif
```

## dts/bindings/staric,ucnet.yaml
```yaml
description: |
  ucLogger over Network

  This is the binding for the ucLog driver using Network TCP sockets.
  This driver protocol matches needs of Unit Circle Logging Framwork.

compatible: "staric,ucnet"

include: [base.yaml]
```

## dts/bindings/staric,ucuart_z.yaml
```yaml
description: |
  ucLogger UART - Zephyr

  This is the binding for the UART driver using Zephyr UART API.
  This driver protocol matches needs of Unit Circle Logging Framwork.

compatible: "staric,ucuart_z"

include: [uart-device.yaml]

properties:
  wakeup-gpios:
    type: phandle-array
    description: |
      The wakeup gpio

  current-speed:
    required: true
    description: |
      Initial baud rate setting for UART. Only a fixed set of baud
      rates are selectable on these devices.
    type: int
```

## lib/Kconfig
```kconfig
# © 2025 Unit Circle Inc

menu "Unit Circle"

config UC_LOG
        bool "Use UC logging framework"
        select UCCOMM
        depends on UCUART || UCUSB || UCUART_Z

if UC_LOG

config UC_FAULT
        bool "Use UC fault handling"
        default n

config UC_LOG_SAVE
        bool "On startup copy log buffer to saved log buffer"
        default n

config UC_LOG_BUF_SIZE
        int "UC size of buffer"
        default 8192


config UC_LOG_SERVER
        bool "Enable support for log server"
        default n

config UC_LOG_MAX_PACKET_SIZE
        int "UC log max packet size"
        default 1500

if UC_LOG_SERVER

config UC_LOG_SERVER_PORTS
        int "UC log server input ports"
        default 8
        help
          "These ports are for application usage"

config UC_LOG_STACK_SIZE
        int "UC log thread stack size"
        default 2048

config UC_LOG_THREAD_PRIORITY
        int "UC log thread priority"
        default 10

config UC_SYSCALLS
        bool "Enable support for stdio fileio using syscalls over UC log"
        default n

config UC_SHELL
        bool "Enable support for shell over UC log"
        default n
        depends on !SHELL_BACKENDS

if UC_SHELL

config UC_SHELL_PROMPT
        string "UC log shell prompt"
        default "uclog$~ "
        help
          Needs to end with "~ " to allow flushing of buffered text.

config UC_SHELL_STACK_SIZE
        int "UC log shell stack size"
        default 512


backend = UC
backend-str = UC
source "subsys/logging/Kconfig.template.log_format_config"

endif

endif
endif

config UC_SIGNED_IMAGE
        bool "Enable support for UC signed images"
        default n

endmenu
```
