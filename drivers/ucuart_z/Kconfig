## drivers/ucuart_z/Kconfig
```kconfig
# © 2026 StarIC Inc.
# SPDX-License-Identifier: Apache-2.0

config UCUART_Z
	bool "ucLog UART (Zephyr API)"
	default y
	depends on DT_HAS_STARIC_UCUART_Z_ENABLED
	depends on UC_LOG
	select UART
	select SERIAL
	select UART_ASYNC_API if SERIAL_SUPPORT_ASYNC
	select NOCACHE_MEMORY if UART_ASYNC_API && SOC_FAMILY_STM32
	select UART_INTERRUPT_DRIVEN if SERIAL_SUPPORT_INTERRUPT
	select UART_USE_RUNTIME_CONFIGURE
	help
	  ucLog UART using Zephyr API

if UCUART_Z

config UCUART_Z_TX_WQ_STACK_SIZE
	int "ucLog UART TX workq stack size"
	default 2048

config UCUART_Z_TX_WQ_THREAD_PRIORITY
	int "ucLog UART TX workq thread priority"
	default 5

module = UCUART_Z
module-str = ucuart_Z
source "subsys/logging/Kconfig.template.log_config"

config UCUART_Z_INIT_PRIORITY
	int "ucuart_Z init priority"
	default 90 # KERNEL_INIT_PRIORITY_DEVICE
	help
	  ucLog UART initialization priority.

# Can include specific alternatives here e.g.
# rsource Kconfig.xxx

endif
```

## drivers/ucusb_z/Kconfig
```kconfig
# SPDX-License-Identifier: Apache-2.0

config UCUSB_Z
    bool "ucLog over USB CDC ACM (Zephyr USB device stack)"
    default y
    depends on DT_HAS_STARIC_UCUSB_Z_ENABLED
    depends on UC_LOG
    select USB_DEVICE_STACK_NEXT
    select EVENTS
    help
      ucLog transport over a USB CDC ACM function. TX data is sent straight
      from the ucLog TX ring buffer, so with CONFIG_UDC_STM32_DMA the OTG_HS
      core DMAs it. This needs CONFIG_UC_LOG_TX_ALIGN4 (from
      patches/uclog-log-tx-align4.patch).

if UCUSB_Z

config UCUSB_Z_VID
    hex "USB vendor ID"
    default 0x2fe3
	help
	  You must use your own VID for samples and applications outside of
	  Zephyr Project.

config UCUSB_Z_PID
    hex "USB product ID"
    default 0x0004
	help
	  You must use your own PID for samples and applications outside of
	  Zephyr Project.

config UCUSB_Z_MANUFACTURER
    string "USB manufacturer string"
    default "Zephyr Project"

config UCUSB_Z_PRODUCT
    string "USB product string"
    default "ucLog USB backend"

config UCUSB_Z_TX_MAX_SIZE
    int "Largest single IN transfer, in bytes"
    default 16384
    help
      Upper bound on how much of the ring one IN transfer takes. Must be a
      multiple of 512 (the high-speed bulk MPS).

config UCUSB_Z_TX_WQ_STACK_SIZE
    int "ucLog USB TX workqueue stack size"
    default 1024

config UCUSB_Z_TX_WQ_THREAD_PRIORITY
    int "ucLog USB TX workqueue thread priority"
    default 5

config UCUSB_Z_INIT_PRIORITY
    int "ucLog USB init priority"
    default 95
    help
      Must be after the USB device stack thread (USBD_THREAD_INIT_PRIO) and
      the UDC driver, and before ucLog attaches to the console at
      APPLICATION level.

module = UCUSB_Z
module-str = ucusb_z
source "subsys/logging/Kconfig.template.log_config"

endif
```

## dts/bindings/staric,ucusb_z.yaml
```yaml
# SPDX-License-Identifier: Apache-2.0
description: |
  ucLog over USB

  USB CDC ACM function carrying the ucLog protocol, on the Zephyr USB device
  stack (device_next). It implements the ucuart API used by the ucLog library
  rather than the Zephyr UART API, and sends straight from the ucLog TX ring
  buffer so the USB controller can DMA it. Place the node under the USB
  device controller node, e.g. zephyr_udc0.

compatible: "staric,ucusb_z"

include: base.yaml

on-bus: usb
```
